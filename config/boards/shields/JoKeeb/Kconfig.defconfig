## config/boards/shields/JoKeeb/Kconfig.defconfig
```kconfig
if SHIELD_JOANNAKEEB_LEFT

config ZMK_KEYBOARD_NAME
    default "JoKeeb"

config ZMK_SPLIT_ROLE_CENTRAL
    default y

endif # JoannaKeebLeft

if SHIELD_JOANNAKEEB_LEFT || SHIELD_JOANNAKEEB_RIGHT

config ZMK_SPLIT
    default y

endif # SHIELD_JOANNAKEEB_LEFT || SHIELD_JOANNAKEEB_RIGHT
```

## config/boards/shields/JoKeeb/Kconfig.shield
```kconfig
config SHIELD_JOANNAKEEB_LEFT
    def_bool $(shields_list_contains,JoKeeb_Left)

config SHIELD_JOANNAKEEB_RIGHT
    def_bool $(shields_list_contains,JoKeeb_Right)
```
